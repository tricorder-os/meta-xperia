## conf/distro/include/distrofeatures.inc
```bitbake
DISTRO_FEATURES_append = " \
  3g \
  alsa \
  bluetooth \
  opengl \
  pulseaudio \
  wifi \
  x11 \
  "

DISTRO_FEATURES_remove = " \
  irda \
  nfs \
  zeroconf \
  wayland \
  wifi \
  "
```

## conf/distro/phonos.conf
```bitbake
# distribution config
DISTRO = "phonos"
DISTRO_NAME = "phonos xperia operating system"
DISTRO_VERSION = "${DATE}"

TARGET_VENDOR = "-sony"

IMAGE_FSTYPES ?= "tar.bz2 ext4"
PACKAGE_CLASSES = "package_deb"

GLIBC_GENERATE_LOCALES = "en_US.UTF-8"
IMAGE_LINGUAS = "en-us"

require conf/distro/include/distrofeatures.inc
```

## conf/layer.conf
```bitbake
#We have a conf and classes directory, add to BBPATH
BBPATH .= ":${LAYERDIR}"

# We have a recipes-* directories, add to BBFILES
BBFILES += "${LAYERDIR}/recipes-*/*/*.bb \
  ${LAYERDIR}/recipes-*/*/*.bbappend"

BBFILE_COLLECTIONS += "xperia"
BBFILE_PATTERN_xperia := "^${LAYERDIR}/"
BBFILE_PRIORITY_xperia = "6"

LAYERVERSION_xperia = "1"

LAYERDEPENDS_xperia = " \
  core \
  openembedded-layer \
  "
```

## conf/machine/honami.conf
```bitbake
#@TYPE: Machine
#@NAME: honami
#@DESCRIPTION: Sony Xperia Z1 (rhine platform)

KERNEL_DEVICETREE = "qcom-msm8974-sony-xperia-honami.dtb"
KERNEL_DEFCONFIG = "qcom_defconfig"

require conf/machine/include/rhine.inc
```

## conf/machine/include/rhine.inc
```bitbake
SOC_FAMILY = "msm8974"

require conf/machine/include/soc-family.inc
require conf/machine/include/arm/arch-armv7a.inc

KERNEL_IMAGETYPE = "Image"

SERIAL_CONSOLE = "115200;ttyHSL0"

MACHINE_ESSENTIAL_EXTRA_RRECOMMENDS += " \
  kernel-modules \
  "

EXTRA_IMAGECMD_ext4 += " -b 4096 "

MACHINE_FEATURES = " \
  usbhost \
  usbgadget \
  alsa \
  screen \
  wifi \
  bluetooth \
  ext2 \
  "

PREFERRED_PROVIDER_u-boot ?= "u-boot"
PREFERRED_PROVIDER_virtual/bootloader ?= "u-boot"
PREFERRED_PROVIDER_virtual/kernel ?= "linux-sony-los"

KERNEL_CMDLINE = "vmalloc=300M console=ttyHSL0,115200,n8 root=/dev/sda65 rootwait"
KERNEL_RAMBASE = "0x00000000"
KERNEL_PAGESIZE = "2048"
RAMDISK_OFFSET = "0x02000000"
TAGS_OFFSET = "0x01E00000"
```

## conf/machine/include/yoshino.inc
```bitbake
SOC_FAMILY = "msm8998"

require conf/machine/include/soc-family.inc
require conf/machine/include/arm/arch-armv8.inc

KERNEL_IMAGETYPE = "Image"

SERIAL_CONSOLE = "115200;ttyMSM0"

MACHINE_ESSENTIAL_EXTRA_RRECOMMENDS += " \
  kernel-modules \
  ${@bb.utils.contains('DISTRO_FEATURES', 'opengl', 'mesa-driver-msm', '', d)} \
  "

EXTRA_IMAGECMD_ext4 += " -b 4096 "

MACHINE_FEATURES = " \
  usbhost \
  usbgadget \
  alsa \
  screen \
  wifi \
  bluetooth \
  ext2 \
  "

PREFERRED_PROVIDER_u-boot ?= "u-boot"
PREFERRED_PROVIDER_virtual/bootloader ?= "u-boot"
PREFERRED_PROVIDER_virtual/kernel ?= "linux-sony"

KERNEL_CMDLINE = "clk_ignore_unused console=ttyMSM0,115200,n8 root=/dev/block/sda65 rootwait"
KERNEL_RAMBASE = "0x80000000"
KERNEL_PAGESIZE = "4096"
RAMDISK_OFFSET = "0x02000000"
TAGS_OFFSET = "0x01E00000"
```

## conf/machine/lilac.conf
```bitbake
#@TYPE: Machine
#@NAME: lilac
#@DESCRIPTION: Sony Xperia XZ1 Compact (yoshino platform)

KERNEL_DEVICETREE = "qcom/msm8998-v2.1-yoshino-lilac_generic.dtb"
KERNEL_DEFCONFIG = "aosp_yoshino_lilac_defconfig"

require conf/machine/include/yoshino.inc
```
